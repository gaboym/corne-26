## config/west.yml
```yaml
manifest:
  remotes:
    - name: zmkfirmware
      url-base: https://github.com/zmkfirmware
    - name: infely                             # new entry (battery widget)
      url-base: https://github.com/infely      # new entry
  projects:
    - name: zmk
      remote: zmkfirmware
      revision: v0.3
      import: app/west.yml
    - name: nice-view-battery                  # new entry (battery widget)
      remote: infely                           # new entry
      revision: main                           # new entry
  self:
    path: config
```
